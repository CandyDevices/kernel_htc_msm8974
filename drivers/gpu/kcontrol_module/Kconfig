## drivers/gpu/kcontrol_module/Kconfig
```kconfig
config KCONTROL_GPU_MODULE_MSM
        bool
        default y
        depends on ARCH_MSM && MODULES && KALLSYMS_ALL
	help
	  Enable Advanced GPU Options in KControl for MSM Devices
```
